#include <carmen/carmen.h>
#include <carmen/ipc.h>
#include <carmen/map.h>
#include <carmen/grid_mapping.h>

int read_string(char *buf, int size, carmen_FILE *fp)
{
  int i;
  int result;
  char c;

  for (i = 0; i < size || size < 0; i++) {
    result = carmen_fgetc(fp);
    c = (char) result;
    if ( result == EOF)
      return -1;
    if (c == '\0') {
      if (size >= 0)
	buf[i] = '\0';
      return i;
    }
    if (size >= 0)
      buf[i] = c;
  }

  buf[size-1] = '\0';
  return -1;
}

static void carmen_map_read_gridmap(carmen_FILE *fin, carmen_FILE *fout)
{
  int size_x, size_y;
  float resolution;
  float *complete_map = NULL;
  carmen_map_t map;

  int chunk_type, chunk_size;
  char chunk_description[12];

  if(carmen_map_advance_to_chunk(fin, CARMEN_MAP_GRIDMAP_CHUNK) < 0) {
      fprintf(stderr, "Error: Could not find a gridmap chunk.\n");
      fprintf(stderr, "       This file is probably not a map file.\n");
      carmen_fclose(fin);
    }

  chunk_type = carmen_fgetc(fin);
  carmen_fread(&chunk_size, sizeof(int), 1, fin);
  carmen_fread(chunk_description, 10, 1, fin);

  chunk_description[10] = '\0';

  if(CARMEN_MAP_CHUNK_IS_NAMED(chunk_type)) {
    if(read_string(NULL, -1, fin) < 0) {
      carmen_warn("Error: Unexpected EOF.\n");
      carmen_fclose(fin);
    }
  }

  carmen_fread(&size_x, sizeof(int), 1, fin);
  carmen_fread(&size_y, sizeof(int), 1, fin);
  carmen_fread(&resolution, sizeof(float), 1, fin);

  printf("%d %d %lf\n", size_x, size_y, resolution);

  carmen_grid_mapping_create_new_map(&map, size_x, size_y, resolution, 'm');
  complete_map = (float *)calloc(map.config.x_size * map.config.y_size, sizeof(float));

  carmen_fread(complete_map, sizeof(float) * size_x * size_y, 1, fin);

  for (int i = 0; i < map.config.x_size * map.config.y_size; i++)
  {
	  map.complete_map[i] = complete_map[i];
  }


  carmen_map_write_all(fout, map.map,
  			map.config.x_size,
  			map.config.y_size,
  			map.config.resolution,
  			(char *)"",	(char *)"", (char *)"", (char *)"Generated by LCAD-UFES",
  			NULL, 0, NULL, 0, NULL, 0);
  free(complete_map);
  free(map.complete_map);
  free(map.map);
}


int 
main(int argc, char **argv)
{
	FILE *flist = fopen(argv[2], "r");
	carmen_FILE *fin;
	carmen_FILE *fout;

	char fname_in[2000];
	char fname_out[2000];
	char map_name[2000];

	if (argc != 5)
	{
		printf("Usage:\n convert_maps_from_float_to_double <number_of_maps> <file_with_map_list.txt> <path_of_float_maps> <path_of_double_maps>\n");
		exit(0);
	}
	
	int number_of_maps = atoi(argv[1]);

	for (int i = 0; i < number_of_maps; i++)
	{
		fscanf(flist, "%s", map_name);
		printf("%s\n", map_name);
		sprintf(fname_in, "%s/%s", argv[3], map_name);
		sprintf(fname_out, "%s/%s", argv[4], map_name);

		fin = carmen_fopen(fname_in, "r");
		fout = carmen_fopen(fname_out, "w");

		carmen_map_read_gridmap(fin, fout);

		carmen_fclose(fin);
		carmen_fclose(fout);
	}
}
